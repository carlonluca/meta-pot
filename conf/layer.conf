## conf/layer.conf
```bitbake
# We have a conf and classes directory, append to BBPATH
BBPATH .= ":${LAYERDIR}"

# We have a recipes directory, add to BBFILES
BBFILES += "${LAYERDIR}/recipes*/*/*.bb ${LAYERDIR}/recipes*/*/*.bbappend ${LAYERDIR}/images/*.bb"

BBFILE_COLLECTIONS += "meta-pot"
BBFILE_PATTERN_meta-pot = "^${LAYERDIR}/"
BBFILE_PRIORITY_meta-pot = "6"
```

## examples/conf/bblayers.conf
```bitbake
# POKY_BBLAYERS_CONF_VERSION is increased each time build/conf/bblayers.conf
# changes incompatibly
POKY_BBLAYERS_CONF_VERSION = "2"

BBPATH = "${TOPDIR}"
BBFILES ?= ""

WORKSPACE="/home/luca/yocto_mount_pyro"
BBLAYERS ?= " \
    ${WORKSPACE}/poky-pyro/meta \
    ${WORKSPACE}/poky-pyro/meta-poky \
    ${WORKSPACE}/poky-pyro/meta-openembedded/meta-oe \
    ${WORKSPACE}/poky-pyro/meta-openembedded/meta-multimedia \
    ${WORKSPACE}/poky-pyro/meta-openembedded/meta-networking \
    ${WORKSPACE}/poky-pyro/meta-openembedded/meta-python \
    ${WORKSPACE}/poky-pyro/meta-raspberrypi-crypto \
    ${WORKSPACE}/poky-pyro/meta-qt5 \
    ${WORKSPACE}/poky-pyro/meta-oracle-java \
    ${WORKSPACE}/poky-pyro/meta-java \
    ${WORKSPACE}/meta-pot \
  "
```

## examples/conf/local.conf
```bitbake
LICENSE_FLAGS_WHITELIST = "commercial oracle_java"
DISTRO_FEATURES = "ext2 ext3 ext4 pam gles2 usbhost ${DISTRO_FEATURES_LIBC}"
DISTRO_FEATURES_BACKFILL_CONSIDERED += "pulseaudio"
PACKAGE_CLASSES = "package_deb"
IMAGE_FEATURES += "package-management ssh-server-openssh"
DISTRO_FEATURES_remove = "X11 wayland"
EXTRA_IMAGE_FEATURES = "debug-tweaks dev-pkgs tools-sdk tools-debug"

PREFERRED_PROVIDER_jpeg = "libjpeg-turbo"
PREFERRED_PROVIDER_jpeg-native = "libjpeg-turbo-native"
PREFERRED_PROVIDER_udev = "eudev"

# Possible provider: cacao-initial-native and jamvm-initial-native
PREFERRED_PROVIDER_virtual/java-initial-native = "cacao-initial-native"

# Possible provider: cacao-native and jamvm-native
PREFERRED_PROVIDER_virtual/java-native = "cacao-native"

# Optional since there is only one provider for now
PREFERRED_PROVIDER_virtual/javac-native = "ecj-bootstrap-native"

VIRTUAL_RUNTIME_init_manager = "sysvinit"
MACHINE_FEATURES_remove = "apm"

SSTATE_DIR = "/home/luca/yocto_mount_pyro/sstate"
DL_DIR = "/home/luca/yocto_mount_pyro/downloads"
#PARALLEL_MAKE = "-j1"
#BB_NUMBER_THREADS = "1"

IMAGE_FSTYPES ?= "rpi-sdimg"

MACHINE = "raspberrypi3"

DISTRO = "poky"
```
